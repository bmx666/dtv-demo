/dts-v1/;

#include "C.dtsi"

/ {
	prop = "TEST1";
	node {
		/delete-property/ prop;
	};
	nodeA {
		prop_test1;
	};
};

&nodeA {
	prop_test2;
};

/delete-node/ &nodeA;
/delete-node/ &nodeB;
/delete-node/ &nodeC;

/ {
	/* delete N/A node and prop */
	/delete-property/ prop_na;
	/delete-node/ node_na;

	/* delete existing node */
	/delete-node/ node;

	/* re-create nodeA again */
	nodeA: nodeA {
		prop_new;
	};

	/* re-create nodeB with label NodeC */
	nodeC: nodeB {
		prop_new;
	};

	/* re-create nodeC with label NodeD */
	nodeD: nodeC {
		prop_new;
	};
};

/* add label for NodeC */
nodeE: &nodeD {};

/ {
	/delete-node/ nodeC;
};
