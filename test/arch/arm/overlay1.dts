/dts-v1/;
/plugin/;

/ {
        fragment@1 {
                target = <&nodeA>;
                __overlay__ {
                        prop_from_overlay;
                        subNodeA: subNodeA {
                                prop_from_overlay_sub;
                        };
                };
        };
};
